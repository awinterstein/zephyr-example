## application/tests/integration/testcase.yaml
```yaml
tests:
  testing.integration:
    build_only: false
    platform_allow:
      - native_sim
    integration_platforms:
      - native_sim
    tags: test_non_volatile_storage
```

## application/tests/unit/testcase.yaml
```yaml
common:
  tags:
    - lib
    - utilities
tests:
  application.example:
    type: unit
    extra_configs:
      - CONFIG_COVERAGE=y
      - CONFIG_COVERAGE_DUMP=y
      - CONFIG_CPP=y
      - CONFIG_STD_CPP2B=y
```

## applications/west.yml
```yaml
manifest:
  # Marks that this file uses that version of the west manifest file format.
  version: "1.2"

  self:
    # The self subsection can be used to control the manifest repository itself.
    path: applications

  remotes:
  - name: zephyrproject-rtos
    url-base: https://github.com/zephyrproject-rtos

  projects:
  - name: zephyr
    path: zephyr
    remote: zephyrproject-rtos
    revision: v3.7.0
    west-commands: scripts/west-commands.yml
    import: true
```
